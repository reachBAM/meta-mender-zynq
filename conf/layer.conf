## conf/layer.conf
```bitbake
# Layer configuration for meta-mender-zynq
# Copyright 2019 Reach Technologies

# We have a conf and classes directory, add to BBPATH
BBPATH .= ":${LAYERDIR}"

# We have recipes-* directories, add to BBFILES
BBFILES += "${LAYERDIR}/recipes-*/*/*.bb \
	${LAYERDIR}/recipes-*/*/*.bbappend"

BBFILE_COLLECTIONS += "mender-zynq"
BBFILE_PATTERN_mender-zynq = "^${LAYERDIR}/"
BBFILE_PRIORITY_mender-zynq = "6"
```
